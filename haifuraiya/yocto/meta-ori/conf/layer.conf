## haifuraiya/yocto/meta-ori/conf/layer.conf
```bitbake
# meta-ori layer configuration

BBPATH .= ":${LAYERDIR}"

BBFILES += "${LAYERDIR}/recipes-*/*/*.bb \
            ${LAYERDIR}/recipes-*/*/*.bbappend"

BBFILE_COLLECTIONS += "ori"
BBFILE_PATTERN_ori = "^${LAYERDIR}/"
BBFILE_PRIORITY_ori = "10"

# This layer is compatible with Honister (which is what xlnx-rel-v2022.2
# actually pairs with — despite Yocto Kirkstone being released in the same
# timeframe) and forward-compatible with Kirkstone. When upgrading the
# Yocto base to a newer release, add the new release name AFTER verifying
# everything still builds clean on it.
LAYERSERIES_COMPAT_ori = "honister kirkstone"

# Layer version (bump when making non-backwards-compatible changes)
LAYERVERSION_ori = "1"

# This layer depends on oe-core (collection name "core"). That's the
# only hard dependency we strictly need — our systemd_%.bbappend extends
# the systemd recipe which is provided by oe-core.
#
# LAYERRECOMMENDS is a soft dependency: bitbake warns if missing but
# doesn't refuse to parse. We document the rest of our context as
# recommendations rather than hard dependencies, so the layer remains
# usable if someone wants to test it standalone against just oe-core.
#
# Note: layer dependencies use *collection names* (set by each layer's
# own BBFILE_COLLECTIONS), not directory names. To find a layer's
# collection name:
#   grep BBFILE_COLLECTIONS sources/<layer>/conf/layer.conf
LAYERDEPENDS_ori = "core"
LAYERRECOMMENDS_ori = "openembedded-layer"
```
