/*
 * system-user.dtsi -- VCK190 memory-loopback: device-tree additions.
 *
 * Copied into the PetaLinux project by `make vck190-import-xsa`.  The
 * generated device tree (pl.dtsi, from the XSA) already describes axi_dma
 * and the two receiver register blocks; this file only changes how Linux
 * binds them:
 *
 *   rx ctrl / rx demod  -> generic-uio, so a userspace tool can mmap the
 *                          receiver's registers (the same maps the sim
 *                          runner writes: OUTPUT_SHIFT, NORM_SQUELCH, the
 *                          timing and carrier gains, the readbacks).
 *   axi_dma             -> stays on the kernel xilinx_dma driver; a dma-proxy
 *                          node gives userspace one MM2S and one S2MM channel
 *                          (module recipe: recipes-modules/dma-proxy; 4 MB
 *                          buffers x 32 x 2 channels = 256 MB of coherent
 *                          memory, hence cma=512M in bootargs).
 *
 * The node labels (rx, axi_dma) are the device-tree generator's, read from
 * pl.dtsi after the first import (2026-10-24): the receiver is ONE node,
 * "rx: haifuraiya_rx_axi@a4010000", with two reg entries (0xa4010000 and
 * 0xa4020000), so generic-uio gives /dev/uio0 with map0 = channelizer
 * registers and map1 = demod registers.
 */
/include/ "system-conf.dtsi"
/ {
	chosen {
		bootargs = "console=ttyAMA0 earlycon=pl011,mmio32,0xFF000000,115200n8 clk_ignore_unused root=/dev/ram0 rw uio_pdrv_genirq.of_id=generic-uio cma=512M";
	};

	dma_proxy {
		compatible = "xlnx,dma_proxy";
		dmas = <&axi_dma 0 &axi_dma 1>;
		dma-names = "dma_proxy_tx", "dma_proxy_rx";
	};
};

/* receiver registers as a UIO device: /dev/uio0, map0 = channelizer ctrl
 * (0xA4010000), map1 = demod (0xA4020000) */
&rx {
	compatible = "generic-uio";
};
